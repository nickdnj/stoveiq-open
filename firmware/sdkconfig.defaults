## firmware/sdkconfig.defaults
```kconfig
# StoveIQ Open Source — ESP-IDF SDK Configuration Defaults
# SPDX-License-Identifier: MIT

# PSRAM (8MB octal SPI on ESP32-S3-WROOM-1-N8R8)
CONFIG_ESP32S3_SPIRAM_SUPPORT=y
CONFIG_SPIRAM_MODE_OCT=y
CONFIG_SPIRAM_SPEED_80M=y
CONFIG_SPIRAM_BOOT_INIT=y
CONFIG_SPIRAM_USE_MALLOC=y
CONFIG_SPIRAM_MALLOC_ALWAYSINTERNAL=4096

# WiFi provisioning via BLE
CONFIG_BT_ENABLED=y
CONFIG_BT_NIMBLE_ENABLED=y
CONFIG_WIFI_PROV_SCAN_MAX_ENTRIES=16

# HTTP server with WebSocket support
CONFIG_HTTPD_WS_SUPPORT=y
CONFIG_HTTPD_MAX_REQ_HDR_LEN=1024

# mDNS
CONFIG_MDNS_MAX_INTERFACES=2

# LittleFS (for cook session logs)
CONFIG_LITTLEFS_MAX_PARTITIONS=1

# SPIFFS (for web UI files)
CONFIG_SPIFFS_MAX_PARTITIONS=1

# NVS
CONFIG_NVS_ENCRYPTION=n

# Watchdog
CONFIG_ESP_TASK_WDT_TIMEOUT_S=30

# Log level
CONFIG_LOG_DEFAULT_LEVEL_INFO=y

# Partition table
CONFIG_PARTITION_TABLE_CUSTOM=y
CONFIG_PARTITION_TABLE_CUSTOM_FILENAME="partitions.csv"
```
